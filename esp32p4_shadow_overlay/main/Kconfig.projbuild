## esp32p4_shadow_overlay/main/Kconfig.projbuild
```kconfig
menu "Example Configuration"
    config EXAMPLE_USED_LDO_CHAN_ID
        int "example used LDO channel ID"
        default 3
        help
            Example used LDO channel ID, you may check datasheet to know more details.

    config EXAMPLE_USED_LDO_VOLTAGE_MV
        int "example used LDO voltage in mV"
        default 2500
        range 0 3300
        help
            Example used LDO voltage, in mV

    config EXAMPLE_CAM_PORT_ISP_MIPI
        bool
        default y

    choice EXAMPLE_MIPI_CSI_DISP_HRES
        bool "Set MIPI CSI horizontal resolution"
        default EXAMPLE_MIPI_CSI_HRES_1024

        config EXAMPLE_MIPI_CSI_HRES_800
            bool "800"
        config EXAMPLE_MIPI_CSI_HRES_1024
            bool "1024"
    endchoice

    config EXAMPLE_MIPI_CSI_DISP_HRES
        int
        default 800 if EXAMPLE_MIPI_CSI_HRES_800
        default 1024 if EXAMPLE_MIPI_CSI_HRES_1024

    choice EXAMPLE_MIPI_CSI_DISP_VRES
        bool "Set MIPI CSI vertical resolution"
        default EXAMPLE_MIPI_CSI_VRES_600

        config EXAMPLE_MIPI_CSI_VRES_600
            bool "600"
        config EXAMPLE_MIPI_CSI_VRES_640
            bool "640"
        config EXAMPLE_MIPI_CSI_VRES_800
            bool "800"
        config EXAMPLE_MIPI_CSI_VRES_1280
            bool "1280"
    endchoice

    config EXAMPLE_MIPI_CSI_DISP_VRES
        int
        default 600 if EXAMPLE_MIPI_CSI_VRES_600
        default 640 if EXAMPLE_MIPI_CSI_VRES_640
        default 800 if EXAMPLE_MIPI_CSI_VRES_800
        default 1280 if EXAMPLE_MIPI_CSI_VRES_1280

    config SHADOW_SERVO_KEYBOARD_ENABLE
        bool "Enable PWM servo keyboard control"
        default y
        help
            Enable UART keyboard control for three PWM servos.

    config SHADOW_SERVO_AUTO_ENABLE
        bool "Enable automatic near-camera shadow reduction servo control"
        default n
        help
            Enable closed-loop PWM control from shadow recognition features.
            Keep this disabled until the linkage and servo travel limits are verified.
            This should not be enabled at the same time as keyboard control because
            both modes use the same LEDC timer and channels.

    config SHADOW_SERVO1_GPIO
        int "Servo 1 PWM GPIO"
        default 1
        range 0 54

    config SHADOW_SERVO2_GPIO
        int "Servo 2 PWM GPIO"
        default 2
        range 0 54

    config SHADOW_SERVO3_GPIO
        int "Servo 3 PWM GPIO"
        default 3
        range 0 54
endmenu
```

## esp32p4_shadow_overlay/sdkconfig.defaults.esp32p4
```kconfig
CONFIG_IDF_EXPERIMENTAL_FEATURES=y
CONFIG_ESP32P4_SELECTS_REV_LESS_V3=y
CONFIG_ESP32P4_REV_MIN_100=y
CONFIG_SPIRAM=y
CONFIG_SPIRAM_SPEED_200M=y
CONFIG_EXAMPLE_LCD_PATTERN_ILI9881C=y
CONFIG_EXAMPLE_MIPI_DSI_DISP_HRES_800=y
CONFIG_EXAMPLE_MIPI_DSI_DISP_VRES_1280=y
CONFIG_EXAMPLE_MIPI_CSI_HRES_800=y
CONFIG_EXAMPLE_MIPI_CSI_VRES_1280=y
# CONFIG_SHADOW_SERVO_KEYBOARD_ENABLE is not set
CONFIG_SHADOW_SERVO1_GPIO=1
CONFIG_SHADOW_SERVO2_GPIO=2
CONFIG_SHADOW_SERVO3_GPIO=3
```
